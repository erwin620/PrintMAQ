# file: PrintMAQ.ioc
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FREERTOS.Tasks01=MachineTask,32,256,StartDefaultTask,Default,NULL,Dynamic,NULL,NULL;HmiTask,24,256,StartTask03,Default,NULL,Dynamic,NULL,NULL;LedTask,8,128,StartTask04,Default,NULL,Dynamic,NULL,NULL
Mcu.Family=STM32F4
Mcu.Name=STM32F407V(E-G)Tx
Mcu.Package=LQFP100
NVIC.PriorityGroup=NVIC_PRIORITYGROUP_4
NVIC.TIM6_DAC_IRQn=true\:15\:0\:false\:false\:true\:false\:false\:true\:true
NVIC.TimeBase=TIM6_DAC_IRQn
NVIC.TimeBaseIP=TIM6
ProjectManager.HeapSize=0x200
ProjectManager.StackSize=0x400
ProjectManager.TargetToolchain=STM32CubeIDE
RCC.AHBFreq_Value=16000000
RCC.APB1Freq_Value=16000000
RCC.APB2Freq_Value=16000000
RCC.CortexFreq_Value=16000000
RCC.HSE_VALUE=25000000
RCC.HSI_VALUE=16000000
RCC.LSE_VALUE=32768
RCC.SYSCLKFreq_VALUE=16000000
RCC.VCOOutputFreq_Value=192000000
VP_FREERTOS_VS_CMSIS_V2.Mode=CMSIS_V2
VP_SYS_VS_tim6.Mode=TIM6
board=custom

// file: Core/Src/main.c
/* USER CODE BEGIN Header */
/**
  ******************************************************************************
  * @file           : main.c
  * @brief          : Main program body
  ******************************************************************************
  * @attention
  *
  * <h2><center>&copy; Copyright (c) 2026 STMicroelectronics.
  * All rights reserved.</center></h2>
  *
  * This software component is licensed by ST under BSD 3-Clause license,
  * the "License"; You may not use this file except in compliance with the
  * License. You may obtain a copy of the License at:
  *                        opensource.org/licenses/BSD-3-Clause
  *
  ******************************************************************************
  */
/* USER CODE END Header */
#include "main.h"
#include "cmsis_os.h"

/* USER CODE BEGIN Includes */
#include "machine.h"
#include "settings.h"
#include "hmi.h"
/* USER CODE END Includes */

/* Definitions for MachineTask */
osThreadId_t MachineTaskHandle;
const osThreadAttr_t MachineTask_attributes = {
  .name = "MachineTask",
  .stack_size = 256 * 4,
  .priority = (osPriority_t) osPriorityAboveNormal,
};
/* Definitions for HmiTask */
osThreadId_t HmiTaskHandle;
const osThreadAttr_t HmiTask_attributes = {
  .name = "HmiTask",
  .stack_size = 256 * 4,
  .priority = (osPriority_t) osPriorityNormal,
};
/* Definitions for LedTask */
osThreadId_t LedTaskHandle;
const osThreadAttr_t LedTask_attributes = {
  .name = "LedTask",
  .stack_size = 128 * 4,
  .priority = (osPriority_t) osPriorityLow,
};

void SystemClock_Config(void);
void StartDefaultTask(void *argument);
void StartTask03(void *argument);
void StartTask04(void *argument);

/* USER CODE BEGIN PFP */
static void MX_GPIO_Init(void);
static void DWT_Init(void);
static void StatusLed_Update(void);
#ifdef PRUEBA_BANCO_SIN_HMI
static void KeyUp_Update(void);
#endif
/* USER CODE END PFP */

int main(void)
{

  /* MCU Configuration--------------------------------------------------------*/

  /* Reset of all peripherals, Initializes the Flash interface and the Systick. */
  HAL_Init();

  /* Configure the system clock */
  SystemClock_Config();

  /* Initialize all configured peripherals */
  /* USER CODE BEGIN 2 */
  MX_GPIO_Init();
  DWT_Init();
  Settings_Init();
  Machine_Init();
  Hmi_Init();
  /* USER CODE END 2 */

  /* Init scheduler */
  osKernelInitialize();

  /* Create the thread(s) */
  /* creation of MachineTask */
  MachineTaskHandle = osThreadNew(StartDefaultTask, NULL, &MachineTask_attributes);

  /* creation of HmiTask */
  HmiTaskHandle = osThreadNew(StartTask03, NULL, &HmiTask_attributes);

  /* creation of LedTask */
  LedTaskHandle = osThreadNew(StartTask04, NULL, &LedTask_attributes);

  /* Start scheduler */
  osKernelStart();

  /* We should never get here as control is now taken by the scheduler */

  /* Infinite loop */
  /* USER CODE BEGIN WHILE */
  /* Inalcanzable: osKernelStart no retorna y el trabajo lo hacen las tareas. */
  while (1)
  {
    /* USER CODE END WHILE */

  }
}

void SystemClock_Config(void)
{
  RCC_OscInitTypeDef RCC_OscInitStruct = {0};
  RCC_ClkInitTypeDef RCC_ClkInitStruct = {0};

  /** Configure the main internal regulator output voltage
  */
  __HAL_RCC_PWR_CLK_ENABLE();
  __HAL_PWR_VOLTAGESCALING_CONFIG(PWR_REGULATOR_VOLTAGE_SCALE1);

  /** Initializes the RCC Oscillators according to the specified parameters
  * in the RCC_OscInitTypeDef structure.
  */
  RCC_OscInitStruct.OscillatorType = RCC_OSCILLATORTYPE_HSI;
  RCC_OscInitStruct.HSIState = RCC_HSI_ON;
  RCC_OscInitStruct.HSICalibrationValue = RCC_HSICALIBRATION_DEFAULT;
  RCC_OscInitStruct.PLL.PLLState = RCC_PLL_NONE;
  if (HAL_RCC_OscConfig(&RCC_OscInitStruct) != HAL_OK)
  {
    Error_Handler();
  }

  /** Initializes the CPU, AHB and APB buses clocks
  */
  RCC_ClkInitStruct.ClockType = RCC_CLOCKTYPE_HCLK|RCC_CLOCKTYPE_SYSCLK
                              |RCC_CLOCKTYPE_PCLK1|RCC_CLOCKTYPE_PCLK2;
  RCC_ClkInitStruct.SYSCLKSource = RCC_SYSCLKSOURCE_HSI;
  RCC_ClkInitStruct.AHBCLKDivider = RCC_SYSCLK_DIV1;
  RCC_ClkInitStruct.APB1CLKDivider = RCC_HCLK_DIV1;
  RCC_ClkInitStruct.APB2CLKDivider = RCC_HCLK_DIV1;

  if (HAL_RCC_ClockConfig(&RCC_ClkInitStruct, FLASH_LATENCY_0) != HAL_OK)
  {
    Error_Handler();
  }
}

/* USER CODE BEGIN 4 */

/* Configura los LEDs, las salidas STEP/DIR de los ejes y las entradas de los sensores. */
static void MX_GPIO_Init(void)
{
  GPIO_InitTypeDef GPIO_InitStruct = {0};

  __HAL_RCC_GPIOA_CLK_ENABLE();
  __HAL_RCC_GPIOB_CLK_ENABLE();
  __HAL_RCC_GPIOC_CLK_ENABLE();

  /* LEDs activos en bajo: SET = apagado */
  HAL_GPIO_WritePin(LED_D2_PORT, LED_D2_PIN | LED_D3_PIN, GPIO_PIN_SET);
  GPIO_InitStruct.Pin = LED_D2_PIN | LED_D3_PIN;
  GPIO_InitStruct.Mode = GPIO_MODE_OUTPUT_PP;
  GPIO_InitStruct.Pull = GPIO_NOPULL;
  GPIO_InitStruct.Speed = GPIO_SPEED_FREQ_LOW;
  HAL_GPIO_Init(LED_D2_PORT, &GPIO_InitStruct);

  /* PUL/DIR en reposo = LOW (sin corriente por el opto del DM556) */
  HAL_GPIO_WritePin(STROKE_PUL_PORT, STROKE_PUL_PIN, GPIO_PIN_RESET);
  HAL_GPIO_WritePin(STROKE_DIR_PORT, STROKE_DIR_PIN, GPIO_PIN_RESET);
  GPIO_InitStruct.Pin = STROKE_PUL_PIN | STROKE_DIR_PIN;
  GPIO_InitStruct.Mode = GPIO_MODE_OUTPUT_PP;
  GPIO_InitStruct.Pull = GPIO_NOPULL;
  GPIO_InitStruct.Speed = GPIO_SPEED_FREQ_HIGH;
  HAL_GPIO_Init(STROKE_PUL_PORT, &GPIO_InitStruct);

  HAL_GPIO_WritePin(SQUEEGEE_PUL_PORT, SQUEEGEE_PUL_PIN, GPIO_PIN_RESET);
  HAL_GPIO_WritePin(SQUEEGEE_DIR_PORT, SQUEEGEE_DIR_PIN, GPIO_PIN_RESET);
  GPIO_InitStruct.Pin = SQUEEGEE_PUL_PIN | SQUEEGEE_DIR_PIN;
  HAL_GPIO_Init(SQUEEGEE_PUL_PORT, &GPIO_InitStruct);

  /* Sensores NPN de colector abierto: necesitan pull-up */
  GPIO_InitStruct.Pin = STROKE_HOME_PIN | SQUEEGEE_HOME_PIN;
  GPIO_InitStruct.Mode = GPIO_MODE_INPUT;
  GPIO_InitStruct.Pull = GPIO_PULLUP;
  HAL_GPIO_Init(STROKE_HOME_PORT, &GPIO_InitStruct);

  GPIO_InitStruct.Pin = PRENDA_PIN;
  HAL_GPIO_Init(PRENDA_PORT, &GPIO_InitStruct);

#ifdef PRUEBA_BANCO_SIN_HMI
  /* El boton no tiene resistencia externa: sin pull-down la entrada quedaria flotando */
  GPIO_InitStruct.Pin = KEY_UP_PIN;
  GPIO_InitStruct.Mode = GPIO_MODE_INPUT;
  GPIO_InitStruct.Pull = GPIO_PULLDOWN;
  HAL_GPIO_Init(KEY_UP_PORT, &GPIO_InitStruct);
#endif
}

/* El contador de ciclos DWT es la base de tiempo de los pulsos y del filtro del sensor. */
static void DWT_Init(void)
{
  CoreDebug->DEMCR |= CoreDebug_DEMCR_TRCENA_Msk;
  DWT->CYCCNT = 0U;
  DWT->CTRL |= DWT_CTRL_CYCCNTENA_Msk;
}

/* D3 refleja el estado de la maquina: apagado = sin home, parpadeo lento = haciendo home,
   fijo = en home, parpadeo muy lento = jog, parpadeo medio = imprimiendo, parpadeo rapido = error. */
static void StatusLed_Update(void)
{
  uint32_t tick = HAL_GetTick();
  uint8_t led_on;

  switch (Machine_GetState())
  {
    case MAQ_HACIENDO_HOME: led_on = ((tick / 250U) % 2U) == 0U; break;
    case MAQ_EN_HOME:       led_on = 1U;                         break;
    case MAQ_JOG:           led_on = ((tick / 500U) % 2U) == 0U; break;
    case MAQ_IMPRIMIENDO:   led_on = ((tick / 125U) % 2U) == 0U; break;
    case MAQ_ERROR:         led_on = ((tick / 62U) % 2U) == 0U;  break;
    /* Destello corto en vez de apagado: distingue "esperando home" de "firmware detenido" */
    case MAQ_SIN_HOME:
    default:                led_on = (tick % 2000U) < 60U;       break;
  }

  HAL_GPIO_WritePin(LED_D3_PORT, LED_D3_PIN, led_on ? GPIO_PIN_RESET : GPIO_PIN_SET);
}

#ifdef PRUEBA_BANCO_SIN_HMI
/* Se llama cada 20 ms desde LedTask: exigir dos lecturas seguidas presionado filtra el rebote.
   Solo el flanco de presion pide el home; mantener el boton no lo repite. */
static void KeyUp_Update(void)
{
  static uint8_t prev_pressed = 0U;
  static uint8_t last_raw = 0U;
  uint8_t raw = (HAL_GPIO_ReadPin(KEY_UP_PORT, KEY_UP_PIN) == KEY_UP_ACTIVE) ? 1U : 0U;
  uint8_t pressed = (raw && last_raw) ? 1U : 0U;
  Machine_State_t st = Machine_GetState();

  /* D2 refleja el boton mientras ningun eje lo usa como indicador de pasos: confirma en banco que PA0 se lee */
  if (st == MAQ_SIN_HOME || st == MAQ_ERROR)
  {
    HAL_GPIO_WritePin(LED_D2_PORT, LED_D2_PIN, raw ? GPIO_PIN_RESET : GPIO_PIN_SET);
  }

  if (pressed && !prev_pressed)
  {
    Machine_RequestHome();
  }
  prev_pressed = pressed;
  last_raw = raw;
}
#endif

/* USER CODE END 4 */

void StartDefaultTask(void *argument)
{
  /* USER CODE BEGIN 5 */
  /* Los pulsos del motor no se generan aqui sino en la interrupcion de TIM7: una tarea
     tendria jitter y estaria limitada a 1 paso por tick del RTOS. */
  for(;;)
  {
    Machine_Update();
    /* Misma tarea que Machine_Update: ningun movimiento puede arrancar a mitad de una grabacion */
    Settings_Update(Machine_IsIdle());
    osDelay(1);
  }
  /* USER CODE END 5 */
}

void StartTask03(void *argument)
{
  /* USER CODE BEGIN StartTask03 */
  /* A 9600 baudios llega como maximo un byte por milisegundo y la interrupcion los bufferea,
     por lo que revisar cada 2 ms no pierde datos. */
  for(;;)
  {
    Hmi_Update();
    osDelay(2);
  }
  /* USER CODE END StartTask03 */
}

void StartTask04(void *argument)
{
  /* USER CODE BEGIN StartTask04 */
  for(;;)
  {
#ifdef PRUEBA_BANCO_SIN_HMI
    KeyUp_Update();
#endif
    StatusLed_Update();
    osDelay(20);
  }
  /* USER CODE END StartTask04 */
}

void HAL_TIM_PeriodElapsedCallback(TIM_HandleTypeDef *htim)
{
  if (htim->Instance == TIM6)
  {
    HAL_IncTick();
  }
}

void Error_Handler(void)
{
}

// file: Core/Src/freertos.c
/* USER CODE BEGIN Header */
/**
  ******************************************************************************
  * File Name          : freertos.c
  * Description        : Code for freertos applications
  ******************************************************************************
  * @attention
  *
  * Copyright (c) 2026 STMicroelectronics.
  * All rights reserved.
  *
  * This software is licensed under terms that can be found in the LICENSE file
  * in the root directory of this software component.
  * If no LICENSE file comes with this software, it is provided AS-IS.
  *
  ******************************************************************************
  */
/* USER CODE END Header */

#include "FreeRTOS.h"
#include "task.h"
#include "main.h"

/* USER CODE BEGIN Application */

/* Fallo fatal del RTOS: detiene todo y deja D2 y D3 encendidos fijos (activos en bajo),
   lo que distingue este fallo del parpadeo normal de estado. */
static void Rtos_Fatal(void)
{
  taskDISABLE_INTERRUPTS();
  HAL_GPIO_WritePin(LED_D2_PORT, LED_D2_PIN | LED_D3_PIN, GPIO_PIN_RESET);
  for (;;)
  {
  }
}

void vApplicationStackOverflowHook(TaskHandle_t xTask, char *pcTaskName)
{
  (void)xTask;
  (void)pcTaskName;
  Rtos_Fatal();
}

void vApplicationMallocFailedHook(void)
{
  Rtos_Fatal();
}

/* USER CODE END Application */
